## snapshot/kernel/drivers/thunderbolt/Kconfig
```kconfig
# SPDX-License-Identifier: GPL-2.0-only
menuconfig USB4
	tristate "Unified support for USB4 and Thunderbolt"
	depends on PCI
	select APPLE_PROPERTIES if EFI_STUB && X86
	select CRC32
	select CRYPTO_LIB_SHA256
	select CRYPTO_LIB_UTILS
	select NVMEM
	help
	  USB4 and Thunderbolt driver. USB4 is the public specification
	  based on the Thunderbolt 3 protocol. This driver is required if
	  you want to hotplug Thunderbolt and USB4 compliant devices on
	  Apple hardware or on PCs with Intel Falcon Ridge or newer.

	  To compile this driver a module, choose M here. The module will be
	  called thunderbolt.

if USB4

config USB4_X1_DIAG
	bool "Private Yoga X1 RAM-only control transport diagnostic"
	depends on USB4=y && ARM64 && OF && ARM_SMMU=y
	depends on !USB4_QCOM
	help
	  Manual, board-guarded host-router configuration reads only. Disables
	  normal Thunderbolt driver registration; not a usable USB4 installation.

config USB4_X1_TYPEC_DIAG
	bool "Private Yoga X1 Type-C retimer diagnostic"
	depends on USB4_X1_DIAG && QCOM_PMIC_GLINK=y
	help
	  Replaces the normal PMIC altmode consumer with a manually enabled,
	  bounded consumer that configures only the Yoga left-rear PS8830 through
	  normal Type-C APIs. Includes a manually requested UCSI 1.2 GET subset,
	  command-completion notification enable and command-only ACKs. No UCSI
	  reset or role changes, MCU connect commands or USB4 tunnels.

config USB4_X1_NATIVE
	bool "Private Yoga X1 native connection-manager candidate"
	depends on USB4_X1_DIAG && !ACPI
	select PCI_ECAM
	help
	  Uses the Yoga manual startup owner and native Linux connection manager
	  instead of the diagnostic rings. Restricted to router 0 and the pinned
	  LaCie. PCIe approval is conditional on its private Yoga PCI0 bridge.
	  Experimental read-only storage candidate, not installation support.

config USB4_X1_EL2_TEST
	bool "Source-only Yoga X1 EL2 PCIe DMA-domain candidate"
	depends on USB4_X1_NATIVE && ARM_SMMU_V3=y && IOMMU_DMA
	default n
	help
	  Separately selected, unbooted experiment. Requires an EL2 boot, an
	  explicit matching DT marker and Linux-owned PCIe SMMUv3 DMA domains.
	  This does not change boot privilege, configure firmware or establish
	  working MSI-X. The public external-device identity stays fail-closed.

config USB4_X1_ADSP_HANDOFF
	bool "Yoga EL2 attach-only ADSP service checkpoint (EXPERIMENTAL)"
	depends on ARM64 && QCOM_Q6V5_PAS
	depends on QCOM_PMIC_GLINK=y && QCOM_SMP2P=y
	default n
	help
	  Separately selected RAM-only checkpoint for full ADSP preloaded by
	  qebspil before EL2 entry. Requires exact Yoga DT markers and existing
	  healthy SMP2P state. No firmware loading, PAS reset or recovery path.
	  This does not establish USB4 or MSI-X success.

config USB4_CONFIGFS
	def_tristate USB4
	depends on CONFIGFS_FS && !(USB4=y && CONFIGFS_FS=m)
	depends on !USB4_X1_NATIVE

config USB4_DEBUGFS_WRITE
	bool "Enable write by debugfs to configuration spaces (DANGEROUS)"
	help
	  Enables writing to device configuration registers through
	  debugfs interface. You can use tools such as Thunderbolt/USB4
	  debugging tools to access these registers. For more
	  information see:

	    https://github.com/intel/tbtools

	  Only enable this if you know what you are doing! Never enable
	  this for production systems or distro kernels.

config USB4_DEBUGFS_MARGINING
	bool "Expose receiver lane margining operations under USB4 ports and retimers (DANGEROUS)"
	depends on DEBUG_FS
	depends on USB4_DEBUGFS_WRITE
	help
	  Enables hardware and software based receiver lane margining
	  support under each USB4 port and retimer, including retimers
	  on the other side of the cable. Used for electrical quality
	  and robustness validation during manufacturing. Should not be
	  enabled by distro kernels.

config USB4_KUNIT_TEST
	bool "KUnit tests" if !KUNIT_ALL_TESTS
	depends on USB4 && KUNIT=y
	default KUNIT_ALL_TESTS

config USB4_DMA_TEST
	tristate "DMA traffic test driver"
	depends on DEBUG_FS
	help
	  This allows sending and receiving DMA traffic through loopback
	  connection. Loopback connection can be done by either special
	  dongle that has TX/RX lines crossed, or by simply connecting a
	  cable back to the host. Only enable this if you know what you
	  are doing. Normal users and distro kernels should say N here.

	  To compile this driver a module, choose M here. The module will be
	  called thunderbolt_dma_test.

config USB4_STREAM
	tristate "Stream data over Thunderbolt/USB4 cable"
	depends on USB4_CONFIGFS
	help
	  This adds support for USB4STREAM protocol that allows two
	  hosts to stream data directly over Thunderbolt/USB4 cable
	  through /dev/tbstreamX devices.

	  To compile this driver a module, choose M here. The module will be
	  called thunderbolt_stream.

config USB4_QCOM
	bool "Qualcomm Glymur USB4 host router (bring-up)"
	depends on OF && QCOM_SMEM && CLK_GLYMUR_GCC && PINCTRL && MFD_SYSCON
	depends on ARCH_QCOM || COMPILE_TEST
	depends on DRM_MSM
	select DRM_DISPLAY_HELPER
	help
	  Platform frontend for the Qualcomm Glymur USB4 host router as
	  captured on the Surface Laptop 8: router firmware upload, MCU
	  startup, the line-interrupt NHI adapter and Type-C mailbox
	  commands. Requires the board's router firmware image under
	  /lib/firmware. Experimental.

endif # USB4
```
